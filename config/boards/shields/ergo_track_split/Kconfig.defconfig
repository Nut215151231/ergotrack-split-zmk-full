## config/boards/shields/ergo_track_split/Kconfig.defconfig
```kconfig
# SPDX-License-Identifier: MIT

if SHIELD_ERGO_TRACK_SPLIT || SHIELD_ERGO_TRACK_SPLIT_LEFT || SHIELD_ERGO_TRACK_SPLIT_RIGHT

config PMW3610
    bool "PMW3610 trackball sensor"
    default y if SHIELD_ERGO_TRACK_SPLIT_RIGHT

config INPUT
    default y if SHIELD_ERGO_TRACK_SPLIT_RIGHT

config ZMK_MOUSE
    default y

config ZMK_POINTING
    default y if SHIELD_ERGO_TRACK_SPLIT_RIGHT

config SPI
    default y if SHIELD_ERGO_TRACK_SPLIT_RIGHT

config SPI_ASYNC
    default y if SHIELD_ERGO_TRACK_SPLIT_RIGHT

config GPIO
    default y

config ZMK_BLE
    default y

endif
```

## config/boards/shields/ergo_track_split/Kconfig.shield
```kconfig
# Copyright (c) 2024
# SPDX-License-Identifier: MIT

config SHIELD_ERGO_TRACK_SPLIT_LEFT
	def_bool $(shields_list_contains,ergo_track_split_left)

config SHIELD_ERGO_TRACK_SPLIT_RIGHT
	def_bool $(shields_list_contains,ergo_track_split_right)
```

## config/west.yml
```yaml
manifest:
  remotes:
    - name: zmkfirmware
      url-base: https://github.com/zmkfirmware
    - name: badjeff
      url-base: https://github.com/badjeff
    - name: nut215151231
      url-base: https://github.com/Nut215151231
  projects:
    - name: zmk
      remote: zmkfirmware
      revision: v0.3
      import: app/west.yml
    - name: zmk-pmw3610-driver
      remote: badjeff
      revision: main
    - name: zmk-battery-led
      remote: nut215151231
      revision: main
  self:
    path: config
```
